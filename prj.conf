## CMakeLists.txt
```
cmake_minimum_required(VERSION 3.20.0)

find_package(Zephyr REQUIRED HINTS $ENV{ZEPHYR_BASE})
project(zephyr-rtos-max3421e)
target_include_directories(app PRIVATE src)

target_sources(app PRIVATE src/main.c src/max3421e.c)
```

## prj.conf
```kconfig
# Enable SPI driver
CONFIG_SPI=y

# Logging
CONFIG_LOG=y
CONFIG_LOG_DEFAULT_LEVEL=3
```

## src/main.c
```c
#include <zephyr/kernel.h>
#include <zephyr/device.h>
#include <zephyr/drivers/spi.h>
#include <zephyr/drivers/gpio.h>
#include <zephyr/logging/log.h>

#include <max3421e.h>

LOG_MODULE_REGISTER(maxtest, LOG_LEVEL_INF);

static const struct spi_dt_spec spi_dev = SPI_DT_SPEC_GET(
    DT_NODELABEL(max3421e),
    SPI_OP_MODE_MASTER | SPI_WORD_SET(8) | SPI_TRANSFER_MSB
);

int main(void)
{
    int ret;
    uint8_t data;

    if (!spi_is_ready_dt(&spi_dev)) {
        LOG_ERR("Error initializing SPI device.");
        return -ENODEV;
    } else {
        LOG_INF("Successfully initialized SPI device.");
    }

    ret = max3421e_enable_fdupspi(spi_dev);
    if (ret) {
        LOG_ERR("Error enabling fdupspi: %d", ret);
        return -1;
    }

    max3421e_read_register(spi_dev, PINCTL_REGISTER, &data);
    if (data == FDUPSPI) {
        LOG_INF("Successfully initialized FDUPSPI.");
    }

    ret = max3421e_resolve_revision_number(spi_dev, &data);
    if (ret) {
        LOG_ERR("Error resolving revision number: %d", ret);
        return -1;
    } else {
        LOG_INF("Successfully read revision number");
    }

    ret = max3421e_enable_host_mode(spi_dev);
    if (ret) {
        LOG_ERR("Error enabling host mode: %d", ret);
    }

    max3421e_read_register(spi_dev, MODE_REGISTER, &data);
    if (data == (DPPULLDN | DMPULLDN | HOST)) {
        LOG_INF("Successfully enabled host mode.");
    } else if (data == (DPPULLDN | DMPULLDN)) {
        LOG_ERR("Could not latch HOST bit. Check your reset pin.");
    } else {
        LOG_ERR("Could not write to MODE register.");
    }

    return 0;
}
```

## src/max3421e.c
```c
#include <max3421e.h>

static bool host_mode_enabled = false;

int max3421e_read_register(const struct spi_dt_spec spi_dev,
                                  int reg,
                                  uint8_t *const data)
{
    int ret;
    uint8_t command = (uint8_t)(reg << 3) | READ_FLAG;

    /*
     * The spi_buf_set type allows us to specify .count = 2
     * to pass a spi_buf with multiple buffers within itself.
     * Zephyr's stock implementation does this, but here we
     * create fdupspi_data[2] to suppress a compiler warning.
     */

    uint8_t fdupspi_data[2] = {
        0x00, /* hirq */
        0x00  /* data */
    };

    const struct spi_buf command_buf = {
        .buf = &command,
        .len = sizeof(command)
    };

    const struct spi_buf data_buf = {
        .buf = &fdupspi_data,
        .len = sizeof(fdupspi_data)
    };

    const struct spi_buf_set command_buf_set = {
        .buffers = &command_buf,
        .count = 1
    };

    const struct spi_buf_set data_buf_set = {
        .buffers = &data_buf,
        .count = 1
    };

    ret = spi_transceive_dt(&spi_dev, &command_buf_set, &data_buf_set) < 0;
    if (ret) {
        return ret;
    }

    /* Set data manually and ignore hirq. */
    *data = fdupspi_data[1];
    return 0;
}

static int max3421e_safe_write_checks(int reg,
                                     const uint8_t data,
                                     bool host_mode_enabled)
{
    /* The MAX3421E ignores Reg values above 31 */
    if (reg > 31) {
        return -EINVAL;
    }

    /*
     * The CPU should never write the RCVFIFO,
     * because it would corrupt the received data. (p. 49)
     */
    if (reg == RCVFIFO_REGISTER) {
        return -EINVAL;
    }

    /* The CPU should never directly clear the SNDBAVIRQ bit. (p. 56) */
    if (reg == HIRQ_REGISTER && data & SNDBAVIRQ) {
        return -EINVAL;
    }

    /* (p. 7) */
    if (host_mode_enabled) {
        if (reg == 9 || reg == 10 || reg == 11) {
            return -EINVAL;
        }

        if ((reg == USBIRQ_REGISTER && data & VBUSIRQ) ||
            (reg == USBIRQ_REGISTER && data & NOVBUSIRQ) ||
            (reg == USBIEN_REGISTER && data & VBUSIE) ||
            (reg == USBIEN_REGISTER && data & NOVBUSIE))
        {
            return -EINVAL;
        }

        if ((reg == PINCTL_REGISTER  && data & 128) ||
            (reg == PINCTL_REGISTER  && data & 64) ||
            (reg == PINCTL_REGISTER  && data & 32))
        {
            return -EINVAL;
        }
    }

    return 0;
}

int max3421e_write_register(const struct spi_dt_spec spi_dev,
                                   int reg,
                                   const uint8_t data)
{
    const int command = (uint8_t)(reg << 3) | WRITE_FLAG;

    uint8_t tx[2] = { command, data };
    const struct spi_buf buf_tx = { .buf = tx, .len = 2 };
    const struct spi_buf_set buf_tx_set = { .buffers = &buf_tx, .count = 1 };

    if (max3421e_safe_write_checks(reg, data, host_mode_enabled)) {
        return -EINVAL;
    } else {
        return spi_write_dt(&spi_dev, &buf_tx_set);
    }
}

int max3421e_get_revision_number(const struct spi_dt_spec spi_dev,
                                 uint8_t *const data)
{
    return max3421e_read_register(spi_dev, REVISION_REGISTER, data);
}

int max3421e_resolve_revision_number(const struct spi_dt_spec spi_dev,
                                     uint8_t *const data)
{
    int ret, len;
    uint8_t revision_hex;

    static const uint8_t revisions[] = {
        0x01, /* Revision 1 */
        0x12, /* Revision 2 */
        0x13, /* Revision 3 */
    };
    len = sizeof(revisions) / sizeof(uint8_t);

    ret = max3421e_get_revision_number(spi_dev, data);
    if (ret) {
        return ret;
    }

    revision_hex = *data;
    for (int i = 0; i < len; i++) {
        if (revision_hex == revisions[i]) {
            *data = (i + 1);
            return 0;
        }
    }

    /* Unknown revision. Return not supported but leave it in *data. */
    return -ENOTSUP;
}

int max3421e_enable_fdupspi(const struct spi_dt_spec spi_dev)
{
    uint8_t enable_fdupspi_message = FDUPSPI;
    return max3421e_write_register(spi_dev, PINCTL_REGISTER, enable_fdupspi_message);
}

int max3421e_enable_host_mode(const struct spi_dt_spec spi_dev)
{
    uint8_t enable_host_mode_message = DPPULLDN | DMPULLDN | HOST;
    host_mode_enabled = true;
    return max3421e_write_register(spi_dev, MODE_REGISTER, enable_host_mode_message);
}
```

## src/max3421e.h
```c
/* max3421e.h - Brief description of what the library does */

#ifndef MAX3421E_H
#define MAX3421E_H

#include <errno.h>
#include <zephyr/drivers/spi.h>

#define MAX3421E_VERSION_MAJOR 1
#define MAX3421E_VERSION_MINOR 0

#define READ_FLAG (uint8_t) 0 << 1
#define WRITE_FLAG (uint8_t) 1 << 1

/* R1: RCVFIFO */
#define RCVFIFO_REGISTER 1

/* R2: SNDFIFO */
#define SNDFIFO_REGISTER 2

/* R4: SUDFIFO */
#define SUDFIFO_REGISTER 4

/* R6: RCVBC */
#define RCVBC_REGISTER 6

/* R7: SNDBC */
#define SNDBC_REGISTER 7

/* R13: USBIRQ */
#define USBIRQ_REGISTER 13
#define VBUSIRQ   (uint8_t) 1 << 6
#define NOVBUSIRQ (uint8_t) 1 << 5
#define OSCOKIRQ  (uint8_t) 1

/* R14: USBIEN */
#define USBIEN_REGISTER 14
#define VBUSIE   (uint8_t) 1 << 6
#define NOVBUSIE (uint8_t) 1 << 5
#define OSCOKIE  (uint8_t) 1

/* R15: USBCTL */
#define USBCTL_REGISTER 15
#define CHIPRES (uint8_t) 1 << 5
#define PWRDOWN (uint8_t) 1 << 4

/* R16: CPUCTL */
#define PULSEWID1 (uint8_t) 1 << 7
#define PULSEWID0 (uint8_t) 1 << 6
#define IE        (uint8_t) 1

/* R17: PINCTRL */
#define PINCTL_REGISTER 17
#define FDUPSPI  (uint8_t) 1 << 4
#define INTLEVEL (uint8_t) 1 << 3
#define POSINT   (uint8_t) 1 << 2
#define GPXB     (uint8_t) 1 << 1
#define GPXA     (uint8_t) 1

/* R18: REVISION */
#define REVISION_REGISTER 18

/* R20: IOPINS1 */
#define IOPINS1_REGISTER 20
#define GPIN3  (uint8_t) 1 << 7
#define GPIN2  (uint8_t) 1 << 6
#define GPIN1  (uint8_t) 1 << 5
#define GPIN0  (uint8_t) 1 << 4
#define GPOUT3 (uint8_t) 1 << 3
#define GPOUT2 (uint8_t) 1 << 2
#define GPOUT1 (uint8_t) 1 << 1
#define GPOUT0 (uint8_t) 1

/* R21: IOPINS2 */
#define IOPINS2_REGISTER 21
#define GPIN7  (uint8_t) 1 << 7
#define GPIN6  (uint8_t) 1 << 6
#define GPIN5  (uint8_t) 1 << 5
#define GPIN4  (uint8_t) 1 << 4
#define GPOUT7 (uint8_t) 1 << 3
#define GPOUT6 (uint8_t) 1 << 2
#define GPOUT5 (uint8_t) 1 << 1
#define GPOUT4 (uint8_t) 1

/* R22: GPINIRQ */
#define GPINIRQ_REGISTER 22
#define GPINIRQ7 (uint8_t) 1 << 7
#define GPINIRQ6 (uint8_t) 1 << 6
#define GPINIRQ5 (uint8_t) 1 << 5
#define GPINIRQ4 (uint8_t) 1 << 4
#define GPINIRQ3 (uint8_t) 1 << 3
#define GPINIRQ2 (uint8_t) 1 << 2
#define GPINIRQ1 (uint8_t) 1 << 1
#define GPINIRQ0 (uint8_t) 1

/* R23: GPINIEN */
#define GPINIEN_REGISTER 23
#define GPINIEN7 (uint8_t) 1 << 7
#define GPINIEN6 (uint8_t) 1 << 6
#define GPINIEN5 (uint8_t) 1 << 5
#define GPINIEN4 (uint8_t) 1 << 4
#define GPINIEN3 (uint8_t) 1 << 3
#define GPINIEN2 (uint8_t) 1 << 2
#define GPINIEN1 (uint8_t) 1 << 1
#define GPINIEN0 (uint8_t) 1

/* R24: GPINPOL */
#define GPINPOL_REGISTER 24
#define GPINPOL7 (uint8_t) 1 << 7
#define GPINPOL6 (uint8_t) 1 << 6
#define GPINPOL5 (uint8_t) 1 << 5
#define GPINPOL4 (uint8_t) 1 << 4
#define GPINPOL3 (uint8_t) 1 << 3
#define GPINPOL2 (uint8_t) 1 << 2
#define GPINPOL1 (uint8_t) 1 << 1
#define GPINPOL0 (uint8_t) 1

/* R25: HIRQ */
#define HIRQ_REGISTER 25
#define HXFRDNIRQ   (uint8_t) 1 << 7
#define FRAMEIRQ    (uint8_t) 1 << 6
#define CONDETIRQ   (uint8_t) 1 << 5
#define SUSDNIRQ    (uint8_t) 1 << 4
#define SNDBAVIRQ   (uint8_t) 1 << 3
#define RCVDAVIRQ   (uint8_t) 1 << 2
#define RWUIRQ      (uint8_t) 1 << 1
#define BUSEVENTIRQ (uint8_t) 1

/* R26: HIEN */
#define HIEN_REGISTER 26
#define HXFRDNIE   (uint8_t) 1 << 7
#define FRAMEIE    (uint8_t) 1 << 6
#define CONDETIE   (uint8_t) 1 << 5
#define SUSDNIE    (uint8_t) 1 << 4
#define SNDBAVIE   (uint8_t) 1 << 3
#define RCVDAVIE   (uint8_t) 1 << 2
#define RWUIE      (uint8_t) 1 << 1
#define BUSEVENTIE (uint8_t) 1

/* R27: MODE */
#define MODE_REGISTER 27
#define DPPULLDN  (uint8_t) 1 << 7
#define DMPULLDN  (uint8_t) 1 << 6
#define DELAYISO  (uint8_t) 1 << 5
#define SEPIRQ    (uint8_t) 1 << 4
#define SOFKAENAB (uint8_t) 1 << 3
#define HUBPRE    (uint8_t) 1 << 2
#define LOWSPEED  (uint8_t) 1 << 1
#define HOST      (uint8_t) 1

/* R28: PERADDR */
#define PERADDR_REGISTER 28

/* R29: HCTL */
#define HCTL_REGISTER 29
#define SNDTOG1   (uint8_t) 1 << 7
#define SNDTOG0   (uint8_t) 1 << 6
#define RCVTOG1   (uint8_t) 1 << 5
#define RCVTOG0   (uint8_t) 1 << 4
#define SIGRSM    (uint8_t) 1 << 3
#define SAMPLEBUS (uint8_t) 1 << 2
#define FRMRST    (uint8_t) 1 << 1
#define BUSRST    (uint8_t) 1

/* R30: HXFR */
#define HXFR_REGISTER 30
#define HS     (uint8_t) 1 << 7
#define ISO    (uint8_t) 1 << 6
#define OUTNIN (uint8_t) 1 << 5
#define SETUP  (uint8_t) 1 << 4
#define EP3    (uint8_t) 1 << 3
#define EP2    (uint8_t) 1 << 2
#define EP1    (uint8_t) 1 << 1
#define EP0    (uint8_t) 1

/* R31: HRSL */
#define HRSL_REGISTER 31
#define JSTATUS  (uint8_t) 1 << 7
#define KSTATUS  (uint8_t) 1 << 6
#define SNDTOGRD (uint8_t) 1 << 5
#define RCVTOGRD (uint8_t) 1 << 4
#define HRSLT3   (uint8_t) 1 << 3
#define HRSLT2   (uint8_t) 1 << 2
#define HRSLT1   (uint8_t) 1 << 1
#define HRSTL0   (uint8_t) 1

static const struct spi_dt_spec spi_dev;
int max3421e_enable_fdupspi(const struct spi_dt_spec spi_dev);
int max3421e_get_revision_number(const struct spi_dt_spec spi_dev, uint8_t *const data);
int max3421e_resolve_revision_number(const struct spi_dt_spec spi_dev, uint8_t *const data);
int max3421e_enable_host_mode(const struct spi_dt_spec spi_dev);
int max3421e_read_register(const struct spi_dt_spec spi_dev, int reg, uint8_t *const data);
int max3421e_write_register(const struct spi_dt_spec spi_dev, int reg, uint8_t const data);

#endif /* MAX3421E_H */
```
